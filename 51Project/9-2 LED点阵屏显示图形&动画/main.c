#include <REGX52.H>
#include "Delay.h"
#include "MatrixLED.h"
#include "UART.h"

////unsigned char MatrixLED[8] = {};
//unsigned char H[8] = {0xFF, 0x10, 0x10,0x10, 0x10, 0x10, 0xFF, 0x00};
//unsigned char E[8] = {0xFF, 0x91, 0x91, 0x91, 0x91, 0x91, 0x91, 0x00};
//unsigned char L[8] = {0xFF, 0x01, 0x01, 0x01, 0x01, 0x01, 0x01, 0x00};
//unsigned char O[8] = {0x3C, 0x42, 0x81, 0x81, 0x81, 0x42, 0x3C, 0x00};

////空心爱心的是38，44，82，41，41，82，44，38
//unsigned char Heart[8] = {0x38, 0x44, 0x82, 0x41, 0x41, 0x82, 0x44, 0x38};
//unsigned char Line[8] = {0x80, 0x40, 0x20, 0x10, 0x08, 0x04, 0x02, 0x01};
//unsigned char Smile[8]  = {0x3C, 0x42, 0xA5, 0x81, 0xA5, 0x99, 0x42, 0x3C};

// Hello!
unsigned char Animation[]={
	0x00,0x00,0x00,0x00,0x00,0x00,0x00,0x00,
	0xFF,0x08,0x08,0x08,0xFF,0x00,0x0E,0x15,
	0x15,0x15,0x08,0x00,0x7E,0x01,0x02,0x00,
	0x7E,0x01,0x02,0x00,0x0E,0x11,0x11,0x0E,
	0x00,0x7D,0x00,0x00,0x00,0x00,0x00,0x00,
	0x00,0x00,0x00,0x00,0x00,0x00,0x00,0x00,
};

// 小火车
unsigned char Train[]={
	0x3C,0x24,0x44,0x52,0x5B,0x4B,0x93,0x0A,0xC2,0x3C,0x18,0x1C,0x62,0x42,0x43,0x43,
	0x43,0x42,0x42,0x3C,0x18,0x3C,0x42,0x42,0x23,0x43,0x43,0x42,0x42,0x2C,0x18,0x18,
};

unsigned char Smile[]={
	0x3C,0x42,0xB5,0x83,0x83,0xB5,0x42,0x3C,
	0x3C,0x42,0xB3,0x85,0x85,0xB3,0x42,0x3C,
};

//坤坤矩阵
//寄存器分为两种，Flash寄存器和RAM
//Flash寄存器的存储空间更大，应用时需要加上code
unsigned char code DH[]=
	{
		0x00,0x0E,0x1B,0x7F,0x7F,0x1B,0x0E,0x00,
		0x00,0x04,0x0C,0x18,0x7F,0x7F,0x1B,0x0E,
		0x00,0x08,0x0C,0x05,0x7F,0x7F,0x1E,0x0C,
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		0x00,0x00,0x00,0x31,0x0A,0x7C,0x7E,0x0D,
};

void main(){
	unsigned char i,j;
	unsigned char Count, Offset=0;  //位移设置
	MatrixLED_Init();

	while(1){	
//        for(i = 0; i < 8; i++){
//            MatrixLED_ShowColumn(i, H[i]);
//        }
//		Delay(500);
//        for(i = 0; i < 8; i++){
//            MatrixLED_ShowColumn(i, E[i]);
//        }
//		Delay(500);
//		for(i = 0; i < 8; i++){
//            MatrixLED_ShowColumn(i, L[i]);
//        }
//		Delay(500);
//		for(i = 0; i < 8; i++){
//            MatrixLED_ShowColumn(i, L[i]);
//        }
//		Delay(500);
//		for(i = 0; i < 8; i++){
//            MatrixLED_ShowColumn(i, O[i]);
//        }
//		Delay(500);
//		for(i = 0; i < 8; i++){
//            MatrixLED_ShowColumn(i, Smile[i]);
//        }
//		Delay(500);
//		for(i = 0; i < 8; i++){
//            MatrixLED_ShowColumn(i, Heart[i]);
//        }
//		Delay(500);

//		// 尝试提取前五列内容
//		MatrixLED_ShowColumn(0, Animation[0]);
//		MatrixLED_ShowColumn(1, Animation[1]);
//		MatrixLED_ShowColumn(2, Animation[2]);
//		MatrixLED_ShowColumn(3, Animation[3]);
//		MatrixLED_ShowColumn(4, Animation[4]);
//		MatrixLED_ShowColumn(5, Animation[5]);
//		
//		// 循环提取
//		for(i=0;i<12;i++){
//			MatrixLED_ShowColumn(i, Animation[i]);
//		}
		
		// 添加位移操作，实现流动字幕显示
		for(i=0;i<8;i++){
			// 通过对Animation[i+Offset]，即可调整横向数列的显示位置
			MatrixLED_ShowColumn(i, DH[i+Offset]);
//			Delay(20);
		}
		Count++;
		// 每扫描十次，Offset就对每个数值增加位移值
		if(Count>15){
			Count=0;
			//闪帧动画的话，则直接以每8个为一位输出
			Offset+=8;
//			Offset++;
			/*问题1：Offset跳跃太大
			c
			Offset += 8;  // 一下子跳8个位置！
			Offset=0时：显示 Smile[0] 到 Smile[7]（帧0）

			Offset=8时：显示 Smile[8] 到 Smile[15]（帧1）✅ 正确

			Offset=16时：显示 Smile[16] 到 Smile[23]（超出数组！访问越界）❌

			问题2：数组访问越界
			Smile数组只有16个元素，但你要访问 Smile[16] 到 Smile[23]，这些是未定义的数据，所以显示乱码。*/
			if(Offset>=10000){
				Offset=0;
			}
		}
    }
}
